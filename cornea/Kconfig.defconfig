## cornea/Kconfig.defconfig
```kconfig
# Copyright (c) 2020 The ZMK Contributors
# SPDX-License-Identifier: MIT

#if SHIELD_CORNEA_LEFT
if SHIELD_CORNEA_RIGHT

config ZMK_KEYBOARD_NAME
	default "Cornea"

config ZMK_SPLIT_BLE_ROLE_CENTRAL
	default y

endif

if SHIELD_CORNEA_LEFT || SHIELD_CORNEA_RIGHT

config ZMK_SPLIT
	default y

endif
```

## cornea/Kconfig.shield
```kconfig
# Copyright (c) 2020 The ZMK Contributors
# SPDX-License-Identifier: MIT

config SHIELD_CORNEA_LEFT
	def_bool $(shields_list_contains,cornea_left)

config SHIELD_CORNEA_RIGHT
	def_bool $(shields_list_contains,cornea_right)
```
